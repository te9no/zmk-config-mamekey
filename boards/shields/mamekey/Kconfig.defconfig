## boards/shields/mamekey/Kconfig.defconfig
```kconfig
if SHIELD_MAMEKEY

# Name must be less than 16 characters long!
config ZMK_KEYBOARD_NAME
        default "mamekey"

endif
```

## config/boards/shields/mamekey/Kconfig.defconfig
```kconfig
if SHIELD_YCORNE_LEFT

# Name must be less than 16 characters long!
config ZMK_KEYBOARD_NAME
        default "mamekey"

endif
```
